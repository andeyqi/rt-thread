## bsp/nxp/mcx/mcxc/frdm-mcxc444/applications/Kconfig
```kconfig
menu "App Config"

    config BSP_USING_ASMTEST
        bool "Enable Asm Test"
        default n

endmenu
```

## bsp/nxp/mcx/mcxn/frdm-mcxn947-core0/applications/Kconfig
```kconfig
menu "Applications Config"

    config APP_USING_MUTEX_TEST
        bool "Enable MUTEX TEST"
        default n

    config APP_USING_VIRTUAL_UART
        bool "Enable virual uart"
        default y

    config APP_USING_HEXDUMP_CMD
        bool "Enable hexdump cmd"
        default y

endmenu
```
